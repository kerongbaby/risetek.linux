## drivers/Kconfig
```kconfig
menu "Device Drivers"

source "drivers/amba/Kconfig"

source "drivers/base/Kconfig"

source "drivers/bus/Kconfig"

source "drivers/mtd/Kconfig"

source "drivers/of/Kconfig"

source "drivers/block/Kconfig"

# misc before ide - BLK_DEV_SGIIOC4 depends on SGI_IOC4

source "drivers/misc/Kconfig"

source "drivers/message/fusion/Kconfig"

source "drivers/net/Kconfig"

# input before char - char/joystick depends on it. As does USB.

source "drivers/input/Kconfig"

source "drivers/char/Kconfig"

source "drivers/spi/Kconfig"

source "drivers/pinctrl/Kconfig"

source "drivers/gpio/Kconfig"

source "drivers/power/Kconfig"

source "drivers/watchdog/Kconfig"

source "drivers/mfd/Kconfig"

source "drivers/regulator/Kconfig"

source "drivers/usb/Kconfig"

source "drivers/leds/Kconfig"

source "drivers/rtc/Kconfig"

source "drivers/dma/Kconfig"

source "drivers/dma-buf/Kconfig"

source "drivers/clk/Kconfig"

source "drivers/clocksource/Kconfig"

source "drivers/soc/Kconfig"

source "drivers/memory/Kconfig"

source "drivers/iio/Kconfig"

source "drivers/pwm/Kconfig"

source "drivers/irqchip/Kconfig"

source "drivers/phy/Kconfig"

endmenu
```
